## conf/distro/include/branding-foundational_sdk.inc
```bitbake
require conf/distro/include/branding-core.inc

# Build for SK device variants for supported SOCs

# For AM68-SK, default tiboot3.bin should be HSFS
IMAGE_BOOT_FILES:j721s2 = "tispl.bin u-boot.img uEnv.txt tiboot3-j721s2-hs-fs-evm.bin;tiboot3.bin"

# For AM69-SK, default tiboot3.bin should be HSFS
IMAGE_BOOT_FILES:j784s4 = "tispl.bin u-boot.img uEnv.txt tiboot3-j784s4-hs-fs-evm.bin;tiboot3.bin"

# Remove run-time dependency for TI ETH firmware in the rootfs
RDEPENDS:${KERNEL_PACKAGE_NAME}-base:remove:j721s2 = "ti-eth-fw"
RDEPENDS:${KERNEL_PACKAGE_NAME}-base:remove:j784s4 = "ti-eth-fw"

# Update defaults in prebuilt-images in bundle
SYSFW_SUFFIX:pn-tisdk-core-bundle:j721s2 = "hs-fs"
SYSFW_SUFFIX:pn-tisdk-core-bundle:j784s4 = "hs-fs"

# Add demos relevant to foundational SDK for am68-sk, am69-sk to tisdk-default-image
IMAGE_INSTALL:append:pn-tisdk-default-image:j721s2 = " ti-apps-launcher"
IMAGE_INSTALL:append:pn-tisdk-default-image:j784s4 = " ti-apps-launcher"
```

## conf/distro/include/branding-psdkla.inc
```bitbake
# Update the list of DTB and DTBOs globally.
# This is to ensure that the recipe for ti-tisdk-makefile picks this for generating makefile
KERNEL_DEVICETREE:append:j721e-evm = " \
    ti/k3-j721e-sk-rpi-hdr-ehrpwm.dtbo \
"
KERNEL_DEVICETREE:append:j721e-hs-evm = " \
    ti/k3-j721e-sk-rpi-hdr-ehrpwm.dtbo \
"
```

## conf/distro/include/sk-build.inc
```bitbake
# Sets variables for SK device types for supported SOCs

# For AM68-SK, default tiboot3.bin should be HSFS
IMAGE_BOOT_FILES:remove:j721s2-evm = "tiboot3.bin"
IMAGE_BOOT_FILES:append:j721s2-evm = " tiboot3-j721s2-hs-fs-evm.bin;tiboot3.bin"

# For AM69-SK, default tiboot3.bin should be HSFS
IMAGE_BOOT_FILES:remove:j784s4-evm = "tiboot3.bin"
IMAGE_BOOT_FILES:append:j784s4-evm = " tiboot3-j784s4-hs-fs-evm.bin;tiboot3.bin"
```

## conf/layer.conf
```bitbake
# We have a conf and classes directory, append to BBPATH
BBPATH .= ":${LAYERDIR}"

# We have a recipes directory, add to BBFILES
BBFILES += "${LAYERDIR}/recipes*/*/*.bb ${LAYERDIR}/recipes*/*/*.bbappend"

BBFILE_COLLECTIONS += "meta-psdkla"
BBFILE_PATTERN_meta-psdkla := "^${LAYERDIR}/"

# We keep the priority higher than all others
BBFILE_PRIORITY_meta-psdkla = "12"

LAYERDEPENDS_meta-psdkla = "core meta-ti-bsp meta-ti-extras meta-arago-distro"

LAYERSERIES_COMPAT_meta-psdkla = "kirkstone"

# Generate -src ipks packages for sources to be added to the SDK installer
require conf/distro/include/arago-source-ipk.inc

# For these SK boards, default tiboot3.bin in all wic images should be HSFS
IMAGE_BOOT_FILES:j721s2:sk = "tispl.bin u-boot.img uEnv.txt tiboot3-j721s2-hs-fs-evm.bin;tiboot3.bin"
IMAGE_BOOT_FILES:j784s4:sk = "tispl.bin u-boot.img uEnv.txt tiboot3-j784s4-hs-fs-evm.bin;tiboot3.bin"
```
